## drivers/misc/mpu3050/Kconfig
```kconfig
menu "Motion Sensors Support"

config MPU_SENSORS_TIMERIRQ
    bool "MPU Timer IRQ"
    help
      If you say yes here you get access to the timerirq device handle which
      can be used to select on.  This can be used instead of IRQ's, sleeping,
      or timer threads.  Reading from this device returns the same type of
      information as reading from the MPU and slave IRQ's.

menuconfig: INV_SENSORS
    tristate "Motion Processing Unit"
    depends on I2C

if INV_SENSORS

choice
    prompt "MPU Master"
    depends on I2C && INV_SENSORS
    optional

config MPU_SENSORS_MPU3050
    bool "MPU3050"
    depends on I2C
    help
      If you say yes here you get support for the MPU3050 Gyroscope driver
      This driver can also be built as a module.  If so, the module
      will be called mpu3050.

endchoice

choice
    prompt "Gyroscope Type"
    depends on I2C && INV_SENSORS
    optional

config MPU_SENSORS_MPU3050_GYRO
    bool "MPU3050 built in gyroscope"
    depends on MPU_SENSORS_MPU3050

config MPU_SENSORS_MPU6050_GYRO
    bool "MPU6050 built in gyroscope"
    depends on MPU_SENSORS_MPU6050B1 || MPU_SENSORS_MPU6050A2

endchoice

choice
    prompt "Accelerometer Type"
    depends on I2C
    optional

config MPU_SENSORS_KXTF9
    bool "Kionix KXTF9"
    depends on MPU_SENSORS_MPU3050
    help
      This enables support for the Kionix KXFT9 accelerometer
endchoice

config MPU_SENSORS_AK8975
    bool "AKM ak8975"
    help
      This enables support for the AKM ak8975 compass

config MPU_SENSORS_YAS529
    bool "Yamaha yas529"
    help
      This enables support for the Yamaha yas529 compass

endif #INV_SENSORS

endmenu
```

## drivers/switch/Kconfig
```kconfig
menuconfig SWITCH
	tristate "Switch class support"
	help
	  Say Y here to enable switch class support. This allows
	  monitoring switches by userspace via sysfs and uevent.

if SWITCH

config SWITCH_GPIO
	tristate "GPIO Swith support"
	depends on GENERIC_GPIO
	help
	  Say Y here to enable GPIO based switch support.

endif # SWITCH

config ROTATELOCK
	tristate "RotationLock Switch support"
	default n

config DOCK_V1
	tristate "Acer Dock support"
	default n

config DOCK_V2
	tristate "Acer Dock 2 support"
	default n

config PSENSOR3G
	tristate "P-Sensor Switch support for 3G"
	default n

config SIMDETECT
	tristate "SIM Hot-swap detection support"
	default n

config PSENSOR
	tristate "P-Sensor Switch support"
	default n
```
